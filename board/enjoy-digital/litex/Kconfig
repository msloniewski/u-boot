## board/enjoy-digital/litex/Kconfig
```kconfig
if TARGET_ENJOY_DIGITAL_LITEX

config SYS_BOARD
	default "litex"

config SYS_VENDOR
	default "enjoy-digital"

config SYS_CPU
	default "generic"

config SYS_CONFIG_NAME
	default "litex"

config SYS_TEXT_BASE
	default 0xc0000000

config BOARD_SPECIFIC_OPTIONS # dummy
	def_bool y
	select GENERIC_RISCV
	imply CMD_DHCP
	imply CMD_EXT2
	imply CMD_EXT4
	imply CMD_FAT
	imply CMD_FS_GENERIC
	imply CMD_NET
	imply CMD_PING
	imply DOS_PARTITION
	imply EFI_PARTITION
	imply IP_DYN
	imply ISO_PARTITION
	imply MACB
	imply MII
	imply NET_RANDOM_ETHADDR
	imply PHY_LIB
	imply PHY_MSCC
	imply LITEX_SERIAL
	imply SMP

endif
```

## configs/litex_defconfig
```kconfig
CONFIG_RISCV=y
CONFIG_SYS_TEXT_BASE=0xC0000000
CONFIG_ENV_SIZE=0x20000
CONFIG_NR_DRAM_BANKS=1
CONFIG_TARGET_ENJOY_DIGITAL_LITEX=y
CONFIG_RISCV_SMODE=y
# CONFIG_RISCV_ISA_C is not set
CONFIG_DISTRO_DEFAULTS=y
CONFIG_FIT=y
CONFIG_MISC_INIT_R=y
CONFIG_DISPLAY_CPUINFO=y
CONFIG_DISPLAY_BOARDINFO=y
CONFIG_DEFAULT_DEVICE_TREE="litex"
CONFIG_SYS_RELOC_GD_ENV_ADDR=y
CONFIG_DM_MTD=y
# CONFIG_REQUIRE_SERIAL_CONSOLE is not set
```
